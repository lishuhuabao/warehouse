#include "includes.h"

/*
**LCD:296*128
*/
#define __LCD_WF29_W  296
#define __LCD_WF29_H  128
#define __LCD_WF29_MAX_PIX 4736

#define __LCD_WF29_CMD_PANEL_SET           0x00
#define __LCD_WF29_CMD_PWR_OFF             0x02
#define __LCD_WF29_CMD_PWR_ON              0x04
#define __LCD_WF29_CMD_BOOT_SOFT_START     0x06
#define __LCD_WF29_CMD_DEEP_SLEEP          0x07
#define __LCD_WF29_CMD_DIS_WB              0x10
#define __LCD_WF29_CMD_DIS_REFRESH         0x12
#define __LCD_WF29_CMD_DIS_WR              0x13
#define __LCD_WF29_CMD_TEMP_SENSOR_CAL     0x40
#define __LCD_WF29_CMD_TEMP_SENSOR_SELECT  0x41
#define __LCD_WF29_CMD_CDI                 0X50
#define __LCD_WF29_CMD_TRES                0x61



#define __LCD_WF29_SDA_GPIO_CLK_ENABLE()      __HAL_RCC_GPIOA_CLK_ENABLE()
#define __LCD_WF29_SDA_PIN                    GPIO_PIN_3
#define __LCD_WF29_SDA_PORT                   GPIOA
#define __LCD_WF29_SDA_(x)                    HAL_GPIO_WritePin(__LCD_WF29_SDA_PORT, __LCD_WF29_SDA_PIN, (GPIO_PinState)(x))
#define __LCD_WF29_SDA_READ                   HAL_GPIO_ReadPin(__LCD_WF29_SDA_PORT, __LCD_WF29_SDA_PIN)	
#define __LCD_WF29_SDA_SET_IN                 BspPinModeSwitch(__LCD_WF29_SDA_PORT, __LCD_WF29_SDA_PIN, BSP_PIN_INPUT)
#define __LCD_WF29_SDA_SET_OUT                BspPinModeSwitch(__LCD_WF29_SDA_PORT, __LCD_WF29_SDA_PIN, BSP_PIN_OUTPUT)

#define __LCD_WF29_CLK_GPIO_CLK_ENABLE()      __HAL_RCC_GPIOA_CLK_ENABLE()
#define __LCD_WF29_CLK_PIN                    GPIO_PIN_2
#define __LCD_WF29_CLK_PORT                   GPIOA
#define __LCD_WF29_CLK_(x)                    HAL_GPIO_WritePin(__LCD_WF29_CLK_PORT, __LCD_WF29_CLK_PIN, (GPIO_PinState)(x))
 
#define __LCD_WF29_CS_GPIO_CLK_ENABLE()      __HAL_RCC_GPIOA_CLK_ENABLE()
#define __LCD_WF29_CS_PIN                    GPIO_PIN_1
#define __LCD_WF29_CS_PORT                   GPIOA
#define __LCD_WF29_CS_(x)                    HAL_GPIO_WritePin(__LCD_WF29_CS_PORT, __LCD_WF29_CS_PIN, (GPIO_PinState)(x))

#define __LCD_WF29_DC_GPIO_CLK_ENABLE()      __HAL_RCC_GPIOA_CLK_ENABLE()
#define __LCD_WF29_DC_PIN                    GPIO_PIN_0
#define __LCD_WF29_DC_PORT                   GPIOA
#define __LCD_WF29_DC_(x)                    HAL_GPIO_WritePin(__LCD_WF29_DC_PORT, __LCD_WF29_DC_PIN, (GPIO_PinState)(x))

#define __LCD_WF29_RST_GPIO_CLK_ENABLE()      __HAL_RCC_GPIOB_CLK_ENABLE()
#define __LCD_WF29_RST_PIN                    GPIO_PIN_8
#define __LCD_WF29_RST_PORT                   GPIOB
#define __LCD_WF29_RST_(x)                    HAL_GPIO_WritePin(__LCD_WF29_RST_PORT, __LCD_WF29_RST_PIN, (GPIO_PinState)(x))	

#define __LCD_WF29_BUSY_GPIO_CLK_ENABLE()      __HAL_RCC_GPIOB_CLK_ENABLE()
#define __LCD_WF29_BUSY_PORT                   GPIOB
#define __LCD_WF29_BUSY_READ                   HAL_GPIO_ReadPin(__LCD_WF29_BUSY_PORT, BSP_LCD_WF29_BUSY_PIN)	

#define __LCD_WF_BUSY_IRQ                     EXTI9_5_IRQn
#define __LCD_WF_BUSY_INT_PRE_PRIO            0
#define __LCD_WF_BUSY_INT_SUB_PRIO            0


/*
**
*/
typedef struct{
	u08 cmd;
	u08 *disDatBuf;
}disColorSt;

static u08 disClorBuf[2][__LCD_WF29_MAX_PIX];

static const  disColorSt disColorStab[] = {
	{__LCD_WF29_CMD_DIS_WB, disClorBuf[0]},
	{__LCD_WF29_CMD_DIS_WR, disClorBuf[1]},
};


const u08 ascNum3[144] = {
	0x00,0x00,0x00,0x00,0x00,0x00,0x00,0x00,0x00,0x00,0x00,0x00,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0x00,
	0x00,0x40,0x00,0x00,0x01,0x00,0x00,0x80,0x01,0x00,0x01,0x00,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0x00,
	0x00,0x78,0x1C,0xC0,0x06,0x00,0x00,0x3F,0xF8,0x70,0x1C,0x00,0x00,0x1F,0xF0,0x3F,0xF8,0x00,0x00,0x07,0xC0,0x1F,0xF0,0x00,0x00,0x00,0x00,0x07,0xC0,0x00,0x00,0x00,0x00,0x00,0x00,0x00,0x00,0x00,0x00,0x00,0x00,0x00,0x00,0x00,0x00,0x00,0x00,0x00,/*"3",0*/
};

const u08 strCharBIN[] = {
	0xFF,0xFF,0xFF,0xFF,0xFC,0x00,0x00,0x1F,0xFC,0x00,0x00,0x1F,0xFC,0x00,0x00,0x1F,0xFC,0xFE,0x7F,0x9F,0xFC,0xFE,0x7F,0x9F,0xFC,0xFE,0x7F,0x9F,0xFC,0xFE,0x7F,0x9F,
	0xFC,0xFE,0x7F,0x9F,0xFC,0x7E,0x3F,0x9F,0xFC,0x7C,0x3F,0x1F,0xFE,0x00,0x1E,0x1F,0xFF,0x01,0x80,0x3F,0xFF,0x83,0xC0,0x7F,0xFF,0xFF,0xE1,0xFF,0xFF,0xFF,0xFF,0xFF,/*"B",0*/
	
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	0xFF,0xFE,0x3F,0x1F,0xFF,0xFF,0xFF,0xFF,0xFF,0xFF,0xFF,0xFF,0xFF,0xFF,0xFF,0xFF,0xFF,0xFF,0xFF,0xFF,0xFF,0xFF,0xFF,0xFF,0xFF,0xFF,0xFF,0xFF,0xFF,0xFF,0xFF,0xFF,/*":",3*/
};

const u08 strCharA01[] = {
	0xFF,0xFF,0xFF,0xFF,0xFF,0xFF,0xFE,0x1F,0xFF,0xFF,0xF0,0x1F,0xFF,0xFF,0x80,0x1F,0xFF,0xF8,0x01,0xFF,0xFF,0xC0,0x07,0xFF,0xFC,0x00,0xC7,0xFF,0xFC,0x0F,0xC7,0xFF,
	0xFC,0x07,0xC7,0xFF,0xFE,0x00,0xC7,0xFF,0xFF,0xE0,0x07,0xFF,0xFF,0xFC,0x00,0xFF,0xFF,0xFF,0x80,0x1F,0xFF,0xFF,0xF8,0x1F,0xFF,0xFF,0xFF,0x1F,0xFF,0xFF,0xFF,0xFF,/*"A",0*/
	
	0xFF,0xFF,0xFF,0xFF,0xFF,0xF0,0x07,0xFF,0xFF,0x80,0x00,0xFF,0xFF,0x00,0x00,0x3F,0xFE,0x1F,0xFC,0x3F,0xFC,0x7F,0xFF,0x1F,0xFC,0xFF,0xFF,0x9F,0xFC,0xFF,0xFF,0x8F,
	0xFC,0xFF,0xFF,0x8F,0xFC,0xFF,0xFF,0x9F,0xFC,0x3F,0xFF,0x1F,0xFE,0x0F,0xF8,0x3F,0xFF,0x00,0x00,0x7F,0xFF,0xC0,0x01,0xFF,0xFF,0xFF,0xFF,0xFF,0xFF,0xFF,0xFF,0xFF,/*"0",1*/
	
	0xFF,0xFF,0xFF,0xFF,0xFF,0xFF,0xFF,0xFF,0xFF,0xFF,0xFF,0xFF,0xFF,0xC7,0xFF,0xFF,0xFF,0xCF,0xFF,0xFF,0xFF,0x9F,0xFF,0xFF,0xFF,0x3F,0xFF,0xFF,0xFC,0x00,0x00,0x1F,
	0xFC,0x00,0x00,0x1F,0xFC,0x00,0x00,0x1F,0xFF,0xFF,0xFF,0xFF,0xFF,0xFF,0xFF,0xFF,0xFF,0xFF,0xFF,0xFF,0xFF,0xFF,0xFF,0xFF,0xFF,0xFF,0xFF,0xFF,0xFF,0xFF,0xFF,0xFF,/*"1",2*/
};


const u08 strCharQTY[] = {
	
	0xFF,0xFF,0xFF,0xFF,0xFF,0xE0,0x03,0xFF,0xFF,0x80,0x00,0x7F,0xFE,0x00,0x00,0x3F,0xFE,0x1F,0xFC,0x1F,0xFC,0x7F,0xFF,0x1F,0xFC,0xFF,0xFF,0x9F,0xFC,0xFF,0xFF,0x8F,
	0xFC,0xFF,0xF3,0x8F,0xFC,0x7F,0xE0,0x9F,0xFC,0x3F,0xF8,0x1F,0xFE,0x0F,0xF8,0x0F,0xFF,0x00,0x00,0x0F,0xFF,0x80,0x00,0xDF,0xFF,0xF8,0x07,0xFF,0xFF,0xFF,0xFF,0xFF,/*"Q",0*/
	
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	0xFF,0xFE,0x3F,0x1F,0xFF,0xFF,0xFF,0xFF,0xFF,0xFF,0xFF,0xFF,0xFF,0xFF,0xFF,0xFF,0xFF,0xFF,0xFF,0xFF,0xFF,0xFF,0xFF,0xFF,0xFF,0xFF,0xFF,0xFF,0xFF,0xFF,0xFF,0xFF,/*":",3*/
	
};

const u08 strNum03[] = {
	0xFF,0xFF,0xFF,0xFF,0xFF,0xF0,0x07,0xFF,0xFF,0x80,0x00,0xFF,0xFF,0x00,0x00,0x3F,0xFE,0x1F,0xFC,0x3F,0xFC,0x7F,0xFF,0x1F,0xFC,0xFF,0xFF,0x9F,0xFC,0xFF,0xFF,0x8F,
	0xFC,0xFF,0xFF,0x8F,0xFC,0xFF,0xFF,0x9F,0xFC,0x3F,0xFF,0x1F,0xFE,0x0F,0xF8,0x3F,0xFF,0x00,0x00,0x7F,0xFF,0xC0,0x01,0xFF,0xFF,0xFF,0xFF,0xFF,0xFF,0xFF,0xFF,0xFF,/*"0",0*/
	
	0xFF,0xFF,0xFF,0xFF,0xFF,0xFF,0xFD,0xFF,0xFF,0x9F,0xFC,0x7F,0xFF,0x0F,0xF8,0x3F,0xFE,0x3F,0xFE,0x1F,0xFC,0x7F,0xFF,0x1F,0xFC,0xFE,0x7F,0x9F,0xFC,0xFE,0x7F,0x8F,
	0xFC,0xFE,0x7F,0x8F,0xFC,0xFC,0x3F,0x9F,0xFC,0x7C,0x3F,0x1F,0xFE,0x01,0x04,0x3F,0xFE,0x01,0x80,0x3F,0xFF,0x87,0xC0,0xFF,0xFF,0xFF,0xFF,0xFF,0xFF,0xFF,0xFF,0xFF,/*"3",1*/
};

const u08 strBL[] = {
	0xFF,0xFF,0xFF,0xFF,0xFC,0x00,0x00,0x1F,0xFC,0x00,0x00,0x1F,0xFC,0x00,0x00,0x1F,0xFC,0xFE,0x7F,0x9F,0xFC,0xFE,0x7F,0x9F,0xFC,0xFE,0x7F,0x9F,0xFC,0xFE,0x7F,0x9F,
	0xFC,0xFE,0x7F,0x9F,0xFC,0x7E,0x3F,0x9F,0xFC,0x7C,0x3F,0x1F,0xFE,0x00,0x1E,0x1F,0xFF,0x01,0x80,0x3F,0xFF,0x83,0xC0,0x7F,0xFF,0xFF,0xE1,0xFF,0xFF,0xFF,0xFF,0xFF,/*"B",0*/
	
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	0xFC,0x1C,0xFF,0x8F,0xFC,0x7C,0xFF,0x8F,0xFC,0xFC,0xFF,0x9F,0xFF,0xFC,0x7F,0x1F,0xFF,0xFE,0x00,0x3F,0xFF,0xFF,0x00,0x7F,0xFF,0xFF,0x80,0xFF,0xFF,0xFF,0xFF,0xFF,/*"6",14*/
};

bspLcdWfSt bspLcdWfS;


/*
**
*/
static void __LcdWrByte(u08 byte);
//static void __LcdWf29DelayMs(u32 xms);
static void __LcdWf29WrDat(u08 command);
static void __LcdWf29WrCmd(u08 command);
//static void __LcdWf29GetSta(void);

static void __LcdWfResetLowForReady(void);
static void __LcdWfResetDelayForReady(void);
static void __LcdWfResetHighForReady(void);
static void __LcdWfGetSta(void);
static void __LcdWfGetStaDelay(void);
static void __LcdWfPwrOn(void);
static void __LcdWfSetPara(void);
static void __LcdWfShowPic_1(void);
static void __LcdWfShowPic_2(void);
static void __LcdRefresh(void);
static void __LcdWfPowerOff(void);
static void __LcdWfDeepSleep(void);

static void (* lcdWfShowPro[])(void) = {
	__LcdWfResetLowForReady, // 0
	__LcdWfResetDelayForReady, // 1
	__LcdWfResetHighForReady, // 2

	__LcdWfGetSta, // 3
	__LcdWfGetStaDelay, // 4
	__LcdWfPwrOn, //5

	__LcdWfGetSta, // 6
 	__LcdWfGetStaDelay, // 7

 	__LcdWfSetPara, // 8

	__LcdWfShowPic_1, //9 //wzh
	__LcdWfShowPic_2, //10
	
	__LcdRefresh, // 11
	




	__LcdWfGetSta, // 12
	__LcdWfGetStaDelay, //13
#if 1


	__LcdWfPowerOff, // 16

	__LcdWfGetSta, // 18
	__LcdWfGetStaDelay, // 19

	__LcdWfDeepSleep, // 20
	#endif
};


/*
**
*/
static void __LcdWrByte(u08 byte)                                    
{                                                           
    u08 i;

	//__LcdDelay(1);
    for(i = 0; i < 8; i++)   
    {
        __LCD_WF29_CLK_(0);
		//__LcdDelay(1);
        if(byte & 0x80)
        {
        	__LCD_WF29_SDA_(1);
        }
        else
        {
        	__LCD_WF29_SDA_(0);	
        }
        byte <<= 1; 
		//__LcdDelay(1);
        __LCD_WF29_CLK_(1); 
        //__LcdDelay(1);
    }
    __LCD_WF29_CLK_(0);
    //__LcdDelay(1);
}

/*
**
*/
static void __LcdWf29WrCmd(u08 command)
{
    //__LcdDelay(1);
    __LCD_WF29_CS_(0);                   
	__LCD_WF29_DC_(0);		// command write
	__LcdWrByte(command);
	__LCD_WF29_CS_(1);
}

/*
**
*/
static void __LcdWf29WrDat(u08 command)
{
    //__LcdDelay(1);
    __LCD_WF29_CS_(0);                   
	__LCD_WF29_DC_(1);		// command write
	__LcdWrByte(command);
	__LCD_WF29_CS_(1);
}
	 

/*
**
*/
void BspLcdWf29Init(void)
{
	GPIO_InitTypeDef __gpioInitSt = {0};

	__LCD_WF29_SDA_GPIO_CLK_ENABLE();

	__LCD_WF29_SDA_(1); 
	
	__gpioInitSt.Pin   = __LCD_WF29_SDA_PIN;
	__gpioInitSt.Mode  = GPIO_MODE_OUTPUT_PP;
	__gpioInitSt.Speed = GPIO_SPEED_FREQ_HIGH;
	HAL_GPIO_Init(__LCD_WF29_SDA_PORT, &__gpioInitSt);

	__LCD_WF29_CLK_GPIO_CLK_ENABLE();
	
	__gpioInitSt.Pin   = __LCD_WF29_CLK_PIN;
	__gpioInitSt.Mode  = GPIO_MODE_OUTPUT_PP;
	__gpioInitSt.Speed = GPIO_SPEED_FREQ_HIGH;
	HAL_GPIO_Init(__LCD_WF29_CLK_PORT, &__gpioInitSt);

	__LCD_WF29_CS_GPIO_CLK_ENABLE();

	__LCD_WF29_CS_(1); 
	
	__gpioInitSt.Pin   = __LCD_WF29_CS_PIN;
	__gpioInitSt.Mode  = GPIO_MODE_OUTPUT_PP;
	__gpioInitSt.Speed = GPIO_SPEED_FREQ_HIGH;
	HAL_GPIO_Init(__LCD_WF29_CS_PORT, &__gpioInitSt);

	__LCD_WF29_DC_GPIO_CLK_ENABLE();

	__LCD_WF29_DC_(1);
	
	__gpioInitSt.Pin   = __LCD_WF29_DC_PIN;
	__gpioInitSt.Mode  = GPIO_MODE_OUTPUT_PP;
	__gpioInitSt.Speed = GPIO_SPEED_FREQ_HIGH;
	HAL_GPIO_Init(__LCD_WF29_DC_PORT, &__gpioInitSt);

	__LCD_WF29_RST_GPIO_CLK_ENABLE();

	__LCD_WF29_RST_(1);
	
	__gpioInitSt.Pin   = __LCD_WF29_RST_PIN;
	__gpioInitSt.Mode  = GPIO_MODE_OUTPUT_PP;
	__gpioInitSt.Speed = GPIO_SPEED_FREQ_HIGH;
	HAL_GPIO_Init(__LCD_WF29_RST_PORT, &__gpioInitSt);
	
	__LCD_WF29_BUSY_GPIO_CLK_ENABLE();
	__gpioInitSt.Pin   = BSP_LCD_WF29_BUSY_PIN;
	__gpioInitSt.Mode  = GPIO_MODE_INPUT;
	__gpioInitSt.Pull  = GPIO_PULLUP;
	__gpioInitSt.Speed = GPIO_SPEED_FREQ_HIGH;
	HAL_GPIO_Init(__LCD_WF29_BUSY_PORT, &__gpioInitSt);


	memset(disColorStab[BSP_LCD_DIS_COLOR_TYPE_WB].disDatBuf, 0xFF, __LCD_WF29_MAX_PIX);
	memset(disColorStab[BSP_LCD_DIS_COLOR_TYPE_WR].disDatBuf, 0xFF, __LCD_WF29_MAX_PIX);
	
}


/*
**
*/
//static void __LcdWf29DelayMs(u32 xms)	
//{	
//	u16 i;
//	u16 j;

//	for(i = 0; i < 1000; i++)
//	{
//		for(j = 0; j < 32; j++)
//		{
//			;
//		}
//	}
//}

/*
**
*/
void BspLcdWf29Test(void)
{
	u08 ascii[32] = {0};
	
    BspLcdWf29FillChar(BSP_LCD_DIS_COLOR_TYPE_WB, 
           			   BSP_GT_CHAR_TYPE_ASC_16X32,
           			   BSP_GT_CHAR_YANG_WEN,
           			   28 - 8, 16, 
           			   "BIN:", //
           			   strlen((const char *) "BIN:"));
    BspLcdWf29FillChar(BSP_LCD_DIS_COLOR_TYPE_WB, 
       			   	   BSP_GT_CHAR_TYPE_ASC_16X32,
       			   	   BSP_GT_CHAR_YANG_WEN,
       			       172 - 8, 16, 
       			       "QTY:", //
       			       strlen((const char *) "QTY:"));

    BspLcdWf29FillChar(BSP_LCD_DIS_COLOR_TYPE_WB, 
   			   	   BSP_GT_CHAR_TYPE_ASC_16X32,
   			   	   BSP_GT_CHAR_YANG_WEN,
   			       28, 80 - 16, 
   			       "BL2011J01123456", //
   			       strlen((const char *) "BL2011J01123456"));

    BspLcdWf29FillChar(BSP_LCD_DIS_COLOR_TYPE_WR, 
           			   BSP_GT_CHAR_TYPE_ASC_16X32,
           			   BSP_GT_CHAR_YANG_WEN,
           			   92 - 8, 16, 
           			   "A010", //
           			   strlen((const char *) "A010"));

    BspLcdWf29FillChar(BSP_LCD_DIS_COLOR_TYPE_WR, 
           			   BSP_GT_CHAR_TYPE_ASC_16X32,
           			   BSP_GT_CHAR_YANG_WEN,
           			   236 - 8, 16, 
           			   "030", //
           			   strlen((const char *) "030"));
       			   
   BspLcdWf29FillChar(BSP_LCD_DIS_COLOR_TYPE_WR, 
           			   BSP_GT_CHAR_TYPE_ASC_8X16,
           			   BSP_GT_CHAR_YANG_WEN,
           			   0 + 28, 112, 
           			   (const u08 *)DisplayVersion, //
           			   strlen((const char *) DisplayVersion));	

	sprintf((char *)ascii, "R:%02x", rstRes);
	BspLcdWf29FillChar(BSP_LCD_DIS_COLOR_TYPE_WR, 
	   			   BSP_GT_CHAR_TYPE_ASC_8X16,
	   			   BSP_GT_CHAR_YANG_WEN,
	   			   0 + 28 + 80, 112, 
	   			   (const u08 *)ascii, //
	   			   strlen((const char *) ascii));	

    sprintf((char *)ascii, "Addr(Hex):%04x", dataSaveS.addr);
   	BspLcdWf29FillChar(BSP_LCD_DIS_COLOR_TYPE_WR, 
           			   BSP_GT_CHAR_TYPE_ASC_8X16,
           			   BSP_GT_CHAR_YANG_WEN,
           			   148 + 28 - 25, 112, 
           			   ascii, //
           			   strlen((const char *) ascii));

	bspLcdWfS.times++;
}

/*
**
*/
void BspLcdWf29ShowPic(bspLcdDisColorTypeEnum type)
{
	u32 i;
	u32 j;

	__LcdWf29WrCmd(disColorStab[type].cmd);	

	for(j = 0; j < __LCD_WF29_W; j++)	
	{
		//for(i = 0; i < __LCD_WF29_H; i+= 8)
		for(i = 0; i < (__LCD_WF29_H >> 3); i++) //wzh
		{
			//__LcdWf29WrDat(disColorStab[type].disDatBuf[(i / 8) * __LCD_WF29_W + j]);   // wzh
			__LcdWf29WrDat(disColorStab[type].disDatBuf[i * __LCD_WF29_W + j]);
		}  
	}
}

/*
**
*/
void BspLcdWf29FillChar(bspLcdDisColorTypeEnum color, bspGtCharTypeEnum charType, bspGtCharYangYinWenTypeEnum yangYin, u16 x, u16 y, const u08 *charCode, u16 len)
{
	u32 i;
	u32 j;
	u08 __image[4736];

	//if(y % 8 || bspGtCharStab[charType].disHigh % 8) //wzh
	if ( (y & 0x0007) || (bspGtCharStab[charType].disHigh & 0x0007))
	{
		//TRACE("显示高度错误!\r\n");
		return;
	}
	bspGtCharStab[charType].gtGetImageFunc((u08 *)charCode, (u32)len / (u32)bspGtCharStab[charType].codeLen, __image, yangYin);


	
	for(j = x; j < x + (u32)bspGtCharStab[charType].disWidth * (u32)len  / (u32)bspGtCharStab[charType].codeLen; j++)
	{
		//for(i = y; i < y + bspGtCharStab[charType].disHigh; i += 8)
		for(i = (y >> 3); i < ((y + bspGtCharStab[charType].disHigh) >> 3); i++) //wzh
		{
			//{
			//	disColorStab[color].disDatBuf[(i / 8) * __LCD_WF29_W + __LCD_WF29_W - j - 1] = __image[(i - y) / 8 + (j - x) * bspGtCharStab[charType].disHigh / 8];
			//}
			disColorStab[color].disDatBuf[i * __LCD_WF29_W + __LCD_WF29_W - j - 1] = __image[i - (y >> 3) + ((j - x) * bspGtCharStab[charType].disHigh >> 3)];
		}
	}
}

/*
**
*/
void BspLcdWf29FillPic(bspLcdDisColorTypeEnum color, u16 x, u16 y, const u08 *pic, u16 width, u16 high)
{
	u32 i;
	u32 j;

	if(y & 0x0007) // if(y % 8) //wzh
	{
		//TRACE("显示高度错误!\r\n");
		return;
	}

	for(j = x; j < x + (u32)width; j++)
	{		
		//for(i = y; i < y + high; i += 8)
		for(i = (y >> 3); i < ((y + high) >> 3); i++) // wzh
		{
			//{
			//	disColorStab[color].disDatBuf[(i / 8) * __LCD_WF29_W + __LCD_WF29_W - j - 1] = pic[(i - y) / 8 + (j - x) * high / 8];
			//}
			disColorStab[color].disDatBuf[i * __LCD_WF29_W + __LCD_WF29_W - j - 1] = pic[i - (y >> 3) + ((j - x) * high >> 3)]; // wzh
		}
	}
}

/*
**
*/
void BspLcdWf29FillArea(bspLcdDisColorTypeEnum color, u16 x, u16 y, u16 width, u16 high, u08 dat)
{
	u32 i;
	u32 j;

	if(y & 0x0007) // if(y % 8) //wzh
	{
		//TRACE("显示高度错误!\r\n");
		return;
	}

	for(j = x; j < x + (u32)width; j++)
	{
		//for(i = y; i < y + high; i += 8)
		for(i = (y >> 3); i < ((y + high) >> 3); i++) // wzh
		{
			//{
			//	disColorStab[color].disDatBuf[(i / 8) * __LCD_WF29_W + __LCD_WF29_W - j - 1] = dat;
			//}
			disColorStab[color].disDatBuf[i * __LCD_WF29_W + __LCD_WF29_W - j - 1] = dat; // wzh
		}
	}
}



/*
**
*/
void BspLcdWf29Clr(bspLcdDisColorTypeEnum type)
{
	u32 i; 

	__LcdWf29WrCmd((u08)disColorStab[type].cmd);  
		
	for(i = 0; i < __LCD_WF29_MAX_PIX; i++)	 
	{
		disColorStab[type].disDatBuf[i] = 0xff;
		//__LcdWf29WrDat(disColorStab[type].disDatBuf[i]);  
	}  
	//__LcdWf29DelayMs(2);	
}




/*
**
*/
void BspRefreshDisAddr(void)
{
	u08 ascii[16] = {0};
	
	sprintf((char *)ascii, "Addr(Hex):%04x", dataSaveS.addr);
   	BspLcdWf29FillChar(BSP_LCD_DIS_COLOR_TYPE_WR, 
           			   BSP_GT_CHAR_TYPE_ASC_8X16,
           			   BSP_GT_CHAR_YANG_WEN,
           			   148 + 28 - 25, 112, 
           			   ascii, //
           			   strlen((const char *) ascii));	
   bspLcdWfS.times++;
}


//static void __LcdWf29GetSta(void)
//{
//	while(1)
//	{	 
//		if(__LCD_WF29_BUSY_READ) 
//		{
//			break;
//		}
//	}   
//	__LcdWf29DelayMs(2);						 
//}


/*
**
*/
void BspLcdRefreshEvent(void)
{
	if(0 == bspLcdWfS.times)
	{
		return;
	}
	lcdWfShowPro[bspLcdWfS.step]();
	ClrPowerEnterTime();
}



/*
**
*/
static void __LcdWfResetLowForReady(void)
{
	__LCD_WF29_RST_(0);		// Module reset

	#if TRACE_LCD_STEP_EN
		TRACE("step is %d\r\n", bspLcdWfS.step);
	#endif
	
	bspLcdWfS.step++;
	

}

/*
**
*/
static void __LcdWfResetDelayForReady(void)
{
	static osDelaySt __osDelayS;
	
	if(DELAY_UNREACH == SystemDelay(&__osDelayS, 1))
	{
		return;
	}

	bspLcdWfS.cnt++;
	if(bspLcdWfS.cnt >= 7)
	{
		#if TRACE_LCD_STEP_EN
		TRACE("step is %d\r\n", bspLcdWfS.step);
		#endif
		bspLcdWfS.step++;
		bspLcdWfS.cnt  = 0;
	}

}

/*
**
*/
static void __LcdWfResetHighForReady(void)
{
	__LCD_WF29_RST_(1);
	
	//BspLcdWfBusyEint();
	
	#if TRACE_LCD_STEP_EN
		TRACE("step is %d\r\n", bspLcdWfS.step);
	#endif
	bspLcdWfS.step++;

}

/*
**
*/
static void __LcdWfGetSta(void)
{
	//BspLcdWfBusyNoEint();
	#if TRACE_LCD_STEP_EN
		TRACE("step is %d\r\n", bspLcdWfS.step);
	#endif
	if(__LCD_WF29_BUSY_READ)
	{
		bspLcdWfS.step++;
	}
}

/*
**
*/
static void __LcdWfGetStaDelay(void)
{
	#if 1
	static osDelaySt __osDelayS;
	
	if(DELAY_UNREACH == SystemDelay(&__osDelayS, 1))
	{
		return;
	}

	bspLcdWfS.cnt++;
	if(bspLcdWfS.cnt >= 2)
	{
		#if TRACE_LCD_STEP_EN
			TRACE("step is %d\r\n", bspLcdWfS.step);
		#endif
		bspLcdWfS.step++;
		bspLcdWfS.cnt  = 0;
	}
	#else
		__LcdWf29DelayMs(2);
		#if TRACE_LCD_STEP_EN
			TRACE("step is %d\r\n", bspLcdWfS.step);
		#endif
		bspLcdWfS.step++;

	#endif

}

/*
**
*/
static void __LcdWfPwrOn(void)
{
	__LcdWf29WrCmd(__LCD_WF29_CMD_BOOT_SOFT_START); //boost设定
	__LcdWf29WrDat(0x17);
	__LcdWf29WrDat(0x17);
	__LcdWf29WrDat(0x17);

	__LcdWf29WrCmd(__LCD_WF29_CMD_PWR_ON); //上电 
	//BspLcdWfBusyEint();
	#if TRACE_LCD_STEP_EN
		TRACE("step is %d\r\n", bspLcdWfS.step);
	#endif
	bspLcdWfS.step++;
}



/*
**
*/
static void __LcdWfSetPara(void)
{
	__LcdWf29WrCmd(__LCD_WF29_CMD_PANEL_SET);
	__LcdWf29WrDat(0x0f); //选择分辨率
	__LcdWf29WrDat(0x0d);

	__LcdWf29WrCmd(__LCD_WF29_CMD_CDI);
	__LcdWf29WrDat(0x77);

	__LcdWf29WrCmd(__LCD_WF29_CMD_TRES); //像素设定
	__LcdWf29WrDat(0x80); //128像素  
	__LcdWf29WrDat(0x01); //296像素 
	__LcdWf29WrDat(0x28);	

	#if TRACE_LCD_STEP_EN
		TRACE("step is %d\r\n", bspLcdWfS.step);
	#endif
	bspLcdWfS.step++;
}


/*
**
*/
static void __LcdWfShowPic_1(void)
{
	BspLcdWf29ShowPic(BSP_LCD_DIS_COLOR_TYPE_WB);	
	#if TRACE_LCD_STEP_EN
		TRACE("step is %d\r\n", bspLcdWfS.step);
	#endif
	bspLcdWfS.step++;
}

/*
**
*/
static void __LcdWfShowPic_2(void)
{	
	BspLcdWf29ShowPic(BSP_LCD_DIS_COLOR_TYPE_WR);
	#if TRACE_LCD_STEP_EN
		TRACE("step is %d\r\n", bspLcdWfS.step);
	#endif
	bspLcdWfS.step++;
}

/*
**
*/
static void __LcdRefresh(void)
{
	__LcdWf29WrCmd(__LCD_WF29_CMD_DIS_REFRESH);
	//BspLcdWfBusyEint();
	#if TRACE_LCD_STEP_EN
		TRACE("step is %d\r\n", bspLcdWfS.step);
	#endif
	bspLcdWfS.step++;
}


/*
**
*/
static void __LcdWfPowerOff(void)
{
	__LcdWf29WrCmd(__LCD_WF29_CMD_PWR_OFF);	//power off
	//BspLcdWfBusyEint();
	
	#if TRACE_LCD_STEP_EN
		TRACE("step is %d\r\n", bspLcdWfS.step);
	#endif
	
	bspLcdWfS.step++;

}



/*
**
*/
static void __LcdWfDeepSleep(void)
{
	__LcdWf29WrCmd(__LCD_WF29_CMD_DEEP_SLEEP);			//deep sleep
	__LcdWf29WrDat(0xA5);

	#if TRACE_LCD_STEP_EN
		TRACE("step is %d\r\n", bspLcdWfS.step);
	#endif
	
	bspLcdWfS.step = 0;

	if(1 == bspLcdWfS.times)
	{
		bspLcdWfS.times = 0;
	}
	else
	{
		bspLcdWfS.times = 1;
	}
}

/*
**
*/
void BspLcdWfBusyEint(void)
{
	GPIO_InitTypeDef __gpioInitSt = {0};

	__LCD_WF29_BUSY_GPIO_CLK_ENABLE();

	__gpioInitSt.Pin   = BSP_LCD_WF29_BUSY_PIN;
	__gpioInitSt.Mode  = GPIO_MODE_IT_RISING;
	__gpioInitSt.Speed = GPIO_SPEED_FREQ_HIGH;
	__gpioInitSt.Pull  = GPIO_PULLUP;
	HAL_GPIO_Init(__LCD_WF29_BUSY_PORT, &__gpioInitSt);

	HAL_NVIC_SetPriority(__LCD_WF_BUSY_IRQ, 0, 0);
	HAL_NVIC_EnableIRQ(__LCD_WF_BUSY_IRQ);
}

void BspLcdWfBusyNoEint(void)
{
	GPIO_InitTypeDef __gpioInitSt = {0};

	__LCD_WF29_BUSY_GPIO_CLK_ENABLE();

	__gpioInitSt.Pin   = BSP_LCD_WF29_BUSY_PIN;
	__gpioInitSt.Mode  = GPIO_MODE_INPUT;
	__gpioInitSt.Speed = GPIO_SPEED_FREQ_HIGH;
	__gpioInitSt.Pull  = GPIO_PULLUP;
	HAL_GPIO_Init(__LCD_WF29_BUSY_PORT, &__gpioInitSt);

	HAL_NVIC_DisableIRQ(__LCD_WF_BUSY_IRQ);
}


/*
**
*/
void BspLcdWfRefreshAddr(void)
{
	u08 ascii[16] = {0};	

	sprintf((char *)ascii, "Addr(Hex):%04x", dataSaveS.addr);
   	BspLcdWf29FillChar(BSP_LCD_DIS_COLOR_TYPE_WR, 
           			   BSP_GT_CHAR_TYPE_ASC_8X16,
           			   BSP_GT_CHAR_YANG_WEN,
           			   148 + 28 - 25, 112, 
           			   ascii, //
           			   strlen((const char *) ascii));
}


